## conf/layer.conf
```bitbake
# We have a conf and classes directory, add to BBPATH
BBPATH .= ":${LAYERDIR}"

# We have a recipes-* directories, add to BBFILES
BBFILES += "${LAYERDIR}/recipes-*/*/*.bb \
	${LAYERDIR}/recipes-*/*/*.bbappend"

BBFILE_COLLECTIONS += "baltos"
BBFILE_PATTERN_baltos = "^${LAYERDIR}/"
BBFILE_PRIORITY_baltos = "6"
```

## conf/machine/baltos.conf
```bitbake
#@TYPE: Machine
#@NAME: baltos

#@DESCRIPTION: Machine configuration for baltos systems


MACHINE_EXTRA_RRECOMMENDS = " kernel-modules kernel-devicetree"

EXTRA_IMAGEDEPENDS += "u-boot"

DEFAULTTUNE ?= "cortexa8hf-neon"
include conf/machine/include/tune-cortexa8.inc

IMAGE_FSTYPES += "tar.bz2"

SERIAL_CONSOLE = "115200 ttyO0"

PREFERRED_PROVIDER_virtual/kernel ?= "linux-yocto-custom"


KERNEL_IMAGETYPE = "zImage"
KERNEL_DEVICETREE = "onrisc-baltos-ir-5221.dtb"
KERNEL_DEVICETREE += "onrisc-baltos-ir-3220.dtb"
KERNEL_DEVICETREE += "onrisc-baltos-ir-2110.dtb"
KERNEL_DEVICETREE += "netcom-plus.dtb"
KERNEL_DEVICETREE += "netcom-plus-omap-uarts.dtb"
KERNEL_DEVICETREE += "netcan.dtb"
KERNEL_EXTRA_ARGS += "LOADADDR=${UBOOT_ENTRYPOINT}"

SPL_BINARY = "MLO"
UBOOT_SUFFIX = "img"
UBOOT_MACHINE = "am335x_baltos_defconfig"
UBOOT_ENTRYPOINT = "0x80008000"
UBOOT_LOADADDRESS = "0x80008000"

MACHINE_FEATURES = "usbgadget usbhost vfat wifi"

IMAGE_BOOT_FILES ?= "u-boot.${UBOOT_SUFFIX} MLO"
```
